## sdkconfig.defaults
```kconfig
# Default sdkconfig overrides for CYD build.
# Ensures Classic Bluetooth (A2DP/AVRCP) is always enabled after idf.py set-target.
CONFIG_BT_ENABLED=y
CONFIG_BT_BLUEDROID_ENABLED=y
CONFIG_BT_CONTROLLER_ENABLED=y
CONFIG_BT_CLASSIC_ENABLED=y
CONFIG_BT_A2DP_ENABLE=y
CONFIG_BT_AVRCP_ENABLED=y
CONFIG_BTDM_CTRL_MODE_BR_EDR_ONLY=y

# Use 3MB app partition so the firmware fits with all features enabled
CONFIG_PARTITION_TABLE_SINGLE_APP_LARGE=y

# Enable PSRAM (SPIRAM) - requires the 4MB PSRAM hardware mod
CONFIG_SPIRAM=y
CONFIG_SPIRAM_MODE_QUAD=y
CONFIG_SPIRAM_SPEED_40M=y
CONFIG_SPIRAM_BOOT_INIT=y
CONFIG_SPIRAM_IGNORE_NOTFOUND=y
CONFIG_SPIRAM_USE_MALLOC=y
CONFIG_SPIRAM_MALLOC_ALWAYSINTERNAL=4096
CONFIG_SPIRAM_MALLOC_RESERVE_INTERNAL=8192
CONFIG_SPIRAM_SUPPORT=y
CONFIG_ESP32_SPIRAM_SUPPORT=y
CONFIG_BT_ALLOCATION_FROM_SPIRAM_FIRST=y
```
